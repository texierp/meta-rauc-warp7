## conf/layer.conf
```bitbake
# We have a conf and classes directory, add to BBPATH
BBPATH .= ":${LAYERDIR}"

# We have recipes-* directories, add to BBFILES
BBFILES += "${LAYERDIR}/recipes-*/*/*.bb \
            ${LAYERDIR}/recipes-*/*/*.bbappend"

BBFILE_COLLECTIONS += "meta-rauc-warp7"
BBFILE_PATTERN_meta-rauc-warp7 = "^${LAYERDIR}/"
BBFILE_PRIORITY_meta-rauc-warp7 = "6"

LAYERSERIES_COMPAT_meta-rauc-warp7 = "zeus dunfell"

# Use systemd as init system
VIRTUAL-RUNTIME_init_manager = "systemd"
DISTRO_FEATURES_BACKFILL_CONSIDERED = "sysvinit"
VIRTUAL-RUNTIME_initscripts = ""
DISTRO_FEATURES_append = " systemd wifi"

KERNEL_MODULE_AUTOLOAD += " brcmfmac"

IMAGE_FEATURES_append = " ssh-server-dropbear"
CORE_IMAGE_EXTRA_INSTALL_append = " rauc rauc-hawkbit packagegroup-base \
	haveged \
	kernel-devicetree curl \
	openssh-sftp-server \
"

IMAGE_BOOT_FILES_append = " boot.scr"
IMAGE_FSTYPES_append = " ext4"
PREFERRED_PROVIDER_u-boot-fw-utils = "u-boot-fslc-fw-utils"
PREFERRED_RPROVIDER_u-boot-fw-utils = "u-boot-fslc-fw-utils"

WKS_FILES_imx7s-warp = "rauc.wks"
```

## wic/rauc.wks
```
part /boot --source bootimg-partition --ondisk mmcblk --fstype=vfat --label boot --active --align 4096 --size 20
part / --source rootfs --ondisk mmcblk --fstype=ext4 --label rootfs_A  --align 8192 --extra-space 200
part / --source rootfs --ondisk mmcblk --fstype=ext4 --label rootfs_B  --align 8192 --extra-space 200
part /data --ondisk mmcblk --fstype=ext4 --label data --size 128M --align 8192 --extra-space 0

bootloader --ptable msdos
```
